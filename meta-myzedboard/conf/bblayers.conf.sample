## meta-myzedboard/conf/bblayers.conf.sample
```bitbake
LCONF_VERSION = "7"

BBPATH = "${TOPDIR}"
BBFILES ?= ""

BBLAYERS ?= " \
  /home/auser/yocto/Xilinx/sources/core/meta \
  /home/auser/yocto/Xilinx/sources/core/meta-poky \
  /home/auser/yocto/Xilinx/sources/core/../meta-openembedded/meta-perl \
  /home/auser/yocto/Xilinx/sources/core/../meta-openembedded/meta-python \
  /home/auser/yocto/Xilinx/sources/core/../meta-openembedded/meta-filesystems \
  /home/auser/yocto/Xilinx/sources/core/../meta-openembedded/meta-gnome \
  /home/auser/yocto/Xilinx/sources/core/../meta-openembedded/meta-multimedia \
  /home/auser/yocto/Xilinx/sources/core/../meta-openembedded/meta-networking \
  /home/auser/yocto/Xilinx/sources/core/../meta-openembedded/meta-webserver \
  /home/auser/yocto/Xilinx/sources/core/../meta-openembedded/meta-xfce \
  /home/auser/yocto/Xilinx/sources/core/../meta-openembedded/meta-initramfs \
  /home/auser/yocto/Xilinx/sources/core/../meta-openembedded/meta-oe \
  /home/auser/yocto/Xilinx/sources/core/../meta-clang \
  /home/auser/yocto/Xilinx/sources/core/../meta-browser \
  /home/auser/yocto/Xilinx/sources/core/../meta-qt5 \
  /home/auser/yocto/Xilinx/sources/core/../meta-xilinx/meta-xilinx-bsp \
  /home/auser/yocto/Xilinx/sources/core/../meta-xilinx/meta-xilinx-pynq \
  /home/auser/yocto/Xilinx/sources/core/../meta-xilinx/meta-xilinx-contrib \
  /home/auser/yocto/Xilinx/sources/core/../meta-xilinx-tools \
  /home/auser/yocto/Xilinx/sources/core/../meta-petalinux \
  /home/auser/yocto/Xilinx/sources/core/../meta-virtualization \
  /home/auser/yocto/Xilinx/sources/core/../meta-openamp \
  /home/auser/yocto/Xilinx/sources/core/../meta-jupyter \
  /home/auser/yocto/Xilinx/sources/core/../meta-vitis-ai \
  /home/auser/yocto/meta-myzedboard \
  "

BBLAYERS_NON_REMOVABLE ?= " \
    /home/auser/yocto/Xilinx/sources/core/meta \
"
```

## meta-myzedboard/conf/layer.conf
```bitbake
# We have a conf and classes directory, add to BBPATH
BBPATH .= ":${LAYERDIR}"

# We have recipes-* directories, add to BBFILES
BBFILES += "${LAYERDIR}/recipes-*/*/*.bb \
            ${LAYERDIR}/recipes-*/*/*.bbappend"

BBFILE_COLLECTIONS += "meta-myzedboard"
BBFILE_PATTERN_meta-myzedboard = "^${LAYERDIR}/"
BBFILE_PRIORITY_meta-myzedboard = "6"

LAYERDEPENDS_meta-myzedboard = "core"
LAYERSERIES_COMPAT_meta-myzedboard = "warrior zeus"
```

## meta-myzedboard/conf/machine/myzedboard.conf
```bitbake
#@TYPE: Machine
#@NAME: myzedboard
#@DESCRIPTION: Machine support for ZedBoard. (http://www.zedboard.org/)
#
# based on Xilinx/sources/meta-xilinx/meta-xilinx-bsp/conf/machine/zedboard-zynq7.conf
# in order to remove changes from local.conf.template
#
# For details on the Evaluation board:
#     http://www.zedboard.org/content/overview
# For design files (including 'zynq_fsbl_0.elf') for the ZedBoard:
#     http://www.zedboard.org/reference-designs-categories/zynq-concepts-tools-and-techniques-zedboard
#

require conf/machine/include/soc-zynq.inc
require conf/machine/include/machine-xilinx-default.inc

# u-boot configuration
UBOOT_MACHINE = "xilinx_zynq_virt_defconfig"
SPL_BINARY ?= "spl/boot.bin"

#check meta-xilinx-tools/recipes-bsp/hdf/external-hdf.bb
#for find out how to replace the HDF if you replace bitstream and dtb
HDF_MACHINE ?= "zedboard-zynq7"

EXTRA_IMAGEDEPENDS += " \
		u-boot-zynq-uenv \
		virtual/boot-bin \
		virtual/bootloader \
		u-boot-zynq-scr \
		"

SERIAL_CONSOLES ?= "115200;ttyPS0"

KERNEL_DEVICETREE = "zynq-zed.dtb"

IMAGE_BOOT_FILES += " \
		boot.bin \
		uEnv.txt \
		boot.scr \
		"

# Remove wic image to avoid circular dependency
IMAGE_FSTYPES_remove = "wic.qemu-sd"
INITRAMFS_IMAGE = "myzedboard-image"
INITRAMFS_IMAGE_BUNDLE = "1"

KERNEL_CLASSES = "kernel-fitimage"
KERNEL_IMAGETYPES += "fitImage"

UBOOT_ENTRYPOINT_zynq  = "0x8000"
UBOOT_LOADADDRESS_zynq = "0x8000"

#it would be nice removing bitstream from boot.bin, but the boot gets stuck
#probably due to problems in dts. 
#BIF_PARTITION_ATTR_remove = "bitstream"


#define AES cryptography
#expand what is defined at 
# Xilinx/meta-xilinx-tools/blob/master/recipes-bsp/bootbin/machine-xilinx-zynq.inc

#[aeskeyfile] secretkey.nky 
#[keysrc_encryption] efuse
#[pskfile] psk0.pem
#[sskfile] ssk0.pem

BIF_COMMON_ATTR = "aeskeyfile keysrc_encryption pskfile sskfile"
BIF_COMMON_ATTR[keysrc_encryption] = "bbram_red_key"
BIF_COMMON_ATTR[aeskeyfile] = "${B}/../aeskey.nky "
BIF_COMMON_ATTR[pskfile] = "${B}/../psk.pem"
BIF_COMMON_ATTR[sskfile] = "${B}/../ssk.pem"

#if we need to pass more parameters to bootgen
BOOTGEN_EXTRA_ARGS = ""

BIF_PARTITION_ATTR[fsbl] = "bootloader, encryption=aes, authentication=rsa"
BIF_PARTITION_ATTR[u-boot] = "encryption=aes, authentication=rsa"
BIF_PARTITION_ATTR[bitstream] = "encryption=aes, authentication=rsa" 
```
